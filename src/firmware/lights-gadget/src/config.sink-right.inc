	#ifndef __KITCHENLEDS_CONFIG_UNITSPECIFIC_INC
	#define __KITCHENLEDS_CONFIG_UNITSPECIFIC_INC

	radix decimal

	; TODO !  THIS FILE NEEDS TO BE CUSTOMISED WITH LOCATION- AND DEVICE-SPECIFIC CONFIGURATION SETTINGS

CONFIG_NUMBER_OF_PIXELS_PARTITION0 equ 16
CONFIG_NUMBER_OF_PIXELS_PARTITION1 equ 0
CONFIG_PARTITION0_IS_LED_D0 equ 1
CONFIG_PARTITION0_IS_REVERSED equ 0
CONFIG_PARTITION1_IS_REVERSED equ 0

CONFIG_POWERMONITOR_VLOW equ low(2494 * 256 / 4096)
CONFIG_POWERMONITOR_VHIGH equ low(3366 * 256 / 4096)

CONFIG_DEFAULT_LIGHTS_ON equ 1

CONFIG_LEDPATTERNS_SWIPEINOUT_DEFAULT_NUMBER_OF_PIXELS_PER_STEP equ 1
CONFIG_LEDPATTERNS_SWIPEINOUT_DEFAULT_NUMBER_OF_DELAY_FRAMES_PER_STEP equ 1

	#endif

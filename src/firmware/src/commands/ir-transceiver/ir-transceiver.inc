	#ifndef __KITCHENLEDS_COMMANDS_IRTRANSCEIVER_IRTRANSCEIVER_INC
	#define __KITCHENLEDS_COMMANDS_IRTRANSCEIVER_IRTRANSCEIVER_INC

	radix decimal

_RECEIVED_BYTE_TIMEOUT equ 2

_POLL_FLAG_SENT_TIMEOUT equ 0

	extern irTransceiverOnByteReceived
	extern irTransceiverOnReceiverFramingError
	extern irTransceiverOnReceiverTimeout
	extern irTransceiverOnReceiverReset

	#ifndef __KITCHENLEDS_COMMANDS_IRTRANSCEIVER_CLC2MODULATEDOUTPUT_ASM
	extern _irTransceiverInitialiseClc2AsModulatedOutput
	#endif

	#ifndef __KITCHENLEDS_COMMANDS_IRTRANSCEIVER_CLC3TXBODGEWIRE_ASM
	extern _irTransceiverInitialiseClc3AsUart2TxBodgeWire
	#endif

	#ifndef __KITCHENLEDS_COMMANDS_IRTRANSCEIVER_UART2_ASM
	extern irTransceiverInitialiseUart2
	#endif

	#ifndef __KITCHENLEDS_COMMANDS_IRTRANSCEIVER_CCP1CARRIERTIMEBASE_ASM
	extern _irTransceiverInitialiseCcp1ForDoubledCarrierWave
	#endif

	#ifndef __KITCHENLEDS_COMMANDS_IRTRANSCEIVER_TMR1CARRIERTIMEBASE_ASM
	extern _irTransceiverInitialiseTimer1ForDoubledCarrierWave
	#endif

	#ifndef __KITCHENLEDS_COMMANDS_IRTRANSCEIVER_UDATA_ASM
	extern _irTransceiverLastReceivedByteTimestamp
	extern _irTransceiverPollState
	#endif

	#endif
